## conf/distro/include/recipes-pn-block.inc
```bitbake
# This inc file is to record all those recipes that are from OE-CORE and useless in ubuntu-toolchain
# when this inc is applied , all recipes won't be depending on OE-CORE recipes unless is confirmed required by ubuntu-toolchain
# recipes-bsp
PNBLACKLIST[acpid] = "Using ubuntu toolchain"
PNBLACKLIST[alsa-state] = "Using ubuntu toolchain"
PNBLACKLIST[apmd] = "Using ubuntu toolchain"
PNBLACKLIST[formfactor] = "Using ubuntu toolchain"
PNBLACKLIST[gnu-efi] = "Using ubuntu toolchain"
PNBLACKLIST[grub-bootconf] = "Using ubuntu toolchain"
PNBLACKLIST[grub-efi] = "Using ubuntu toolchain"
PNBLACKLIST[grub] = "Using ubuntu toolchain"
PNBLACKLIST[keymaps] = "Using ubuntu toolchain"
PNBLACKLIST[libacpi] = "Using ubuntu toolchain"
PNBLACKLIST[lrzsz] = "Using ubuntu toolchain"
PNBLACKLIST[pciutils] = "Using ubuntu toolchain"
PNBLACKLIST[pm-utils] = "Using ubuntu toolchain"
PNBLACKLIST[setserial] = "Using ubuntu toolchain"
PNBLACKLIST[u-boot-fw-utils] = "Using ubuntu toolchain"
PNBLACKLIST[u-boot-mkimage] = "Using ubuntu toolchain"
PNBLACKLIST[u-boot] = "Using ubuntu toolchain"
PNBLACKLIST[usbinit] = "Using ubuntu toolchain"
PNBLACKLIST[usbutils] = "Using ubuntu toolchain"
PNBLACKLIST[v86d] = "Using ubuntu toolchain"
# recipes-devtools
PNBLACKLIST[apt] = "Using ubuntu toolchain"
#PNBLACKLIST[autoconf-archive] = "Using ubuntu toolchain"
PNBLACKLIST[autoconf] = "Using ubuntu toolchain"
PNBLACKLIST[automake] = "Using ubuntu toolchain"
PNBLACKLIST[binutils-cross-canadian] = "Using ubuntu toolchain"
PNBLACKLIST[binutils-cross] = "Using ubuntu toolchain"
PNBLACKLIST[binutils-crosssdk] = "Using ubuntu toolchain"
PNBLACKLIST[bootchart2] = "Using ubuntu toolchain"
PNBLACKLIST[btrfs-tools] = "Using ubuntu toolchain"
PNBLACKLIST[build-compare] = "Using ubuntu toolchain"
PNBLACKLIST[ccache] = "Using ubuntu toolchain"
PNBLACKLIST[chrpath] = "Using ubuntu toolchain"
PNBLACKLIST[cmake] = "Using ubuntu toolchain"
PNBLACKLIST[createrepo-c] = "Using ubuntu toolchain"
PNBLACKLIST[cve-check-tool] = "Using ubuntu toolchain"
PNBLACKLIST[desktop-file-utils] = "Using ubuntu toolchain"
PNBLACKLIST[distcc-config] = "Using ubuntu toolchain"
PNBLACKLIST[nfs-export-root] = "Using ubuntu toolchain"
PNBLACKLIST[diffstat] = "Using ubuntu toolchain"
PNBLACKLIST[distcc] = "Using ubuntu toolchain"
PNBLACKLIST[dmidecode] = "Using ubuntu toolchain"
PNBLACKLIST[dnf] = "Using ubuntu toolchain"
PNBLACKLIST[docbook-xml-dtd4] = "Using ubuntu toolchain"
PNBLACKLIST[docbook-xsl-stylesheets] = "Using ubuntu toolchain"
PNBLACKLIST[dosfstools] = "Using ubuntu toolchain"
PNBLACKLIST[dwarfsrcfiles] = "Using ubuntu toolchain"
PNBLACKLIST[expect] = "Using ubuntu toolchain"
PNBLACKLIST[gptfdisk] = "Using ubuntu toolchain"
PNBLACKLIST[file] = "Using ubuntu toolchain"
PNBLACKLIST[gcc-cross-canadian] = "Using ubuntu toolchain"
PNBLACKLIST[gcc-cross-canadian] = "Using ubuntu toolchain"
PNBLACKLIST[gcc-cross-initial] = "Using ubuntu toolchain"
PNBLACKLIST[gcc-cross-initial] = "Using ubuntu toolchain"
PNBLACKLIST[gcc-cross] = "Using ubuntu toolchain"
PNBLACKLIST[gcc-cross] = "Using ubuntu toolchain"
PNBLACKLIST[gcc-crosssdk-initial] = "Using ubuntu toolchain"
PNBLACKLIST[gcc-crosssdk-initial] = "Using ubuntu toolchain"
PNBLACKLIST[gcc-crosssdk] = "Using ubuntu toolchain"
PNBLACKLIST[gcc-crosssdk] = "Using ubuntu toolchain"
PNBLACKLIST[gcc-runtime] = "Using ubuntu toolchain"
PNBLACKLIST[gcc-runtime] = "Using ubuntu toolchain"
PNBLACKLIST[gcc-sanitizers] = "Using ubuntu toolchain"
PNBLACKLIST[gcc-sanitizers] = "Using ubuntu toolchain"
PNBLACKLIST[gcc-source] = "Using ubuntu toolchain"
PNBLACKLIST[gcc-source] = "Using ubuntu toolchain"
PNBLACKLIST[gcc] = "Using ubuntu toolchain"
PNBLACKLIST[gcc] = "Using ubuntu toolchain"
PNBLACKLIST[libgcc-initial] = "Using ubuntu toolchain"
PNBLACKLIST[libgcc-initial] = "Using ubuntu toolchain"
PNBLACKLIST[libgcc] = "Using ubuntu toolchain"
PNBLACKLIST[libgcc] = "Using ubuntu toolchain"
PNBLACKLIST[libgfortran] = "Using ubuntu toolchain"
PNBLACKLIST[libgfortran] = "Using ubuntu toolchain"
PNBLACKLIST[gdb-cross-canadian] = "Using ubuntu toolchain"
PNBLACKLIST[gdb-cross] = "Using ubuntu toolchain"
PNBLACKLIST[gdb] = "Using ubuntu toolchain"
PNBLACKLIST[git] = "Using ubuntu toolchain"
PNBLACKLIST[glide] = "Using ubuntu toolchain"
PNBLACKLIST[gnu-config] = "Using ubuntu toolchain"
PNBLACKLIST[go-cross-canadian] = "Using ubuntu toolchain"
PNBLACKLIST[go-cross-canadian] = "Using ubuntu toolchain"
PNBLACKLIST[go-cross] = "Using ubuntu toolchain"
PNBLACKLIST[go-cross] = "Using ubuntu toolchain"
PNBLACKLIST[go-crosssdk] = "Using ubuntu toolchain"
PNBLACKLIST[go-crosssdk] = "Using ubuntu toolchain"
PNBLACKLIST[go-dep] = "Using ubuntu toolchain"
PNBLACKLIST[go-runtime] = "Using ubuntu toolchain"
PNBLACKLIST[go-runtime] = "Using ubuntu toolchain"
PNBLACKLIST[go] = "Using ubuntu toolchain"
PNBLACKLIST[go] = "Using ubuntu toolchain"
PNBLACKLIST[i2c-tools] = "Using ubuntu toolchain"
PNBLACKLIST[icecc-create-env] = "Using ubuntu toolchain"
PNBLACKLIST[intltool] = "Using ubuntu toolchain"
PNBLACKLIST[json-c] = "Using ubuntu toolchain"
PNBLACKLIST[libcomps] = "Using ubuntu toolchain"
PNBLACKLIST[libdnf] = "Using ubuntu toolchain"
PNBLACKLIST[librepo] = "Using ubuntu toolchain"
PNBLACKLIST[llvm] = "Using ubuntu toolchain"
PNBLACKLIST[make] = "Using ubuntu toolchain"
PNBLACKLIST[makedevs] = "Using ubuntu toolchain"
PNBLACKLIST[meson] = "Using ubuntu toolchain"
PNBLACKLIST[mmc-utils] = "Using ubuntu toolchain"
PNBLACKLIST[mtd-utils] = "Using ubuntu toolchain"
PNBLACKLIST[mtools] = "Using ubuntu toolchain"
PNBLACKLIST[nasm] = "Using ubuntu toolchain"
PNBLACKLIST[ninja] = "Using ubuntu toolchain"
PNBLACKLIST[opkg-arch-config] = "Using ubuntu toolchain"
PNBLACKLIST[opkg-keyrings] = "Using ubuntu toolchain"
PNBLACKLIST[opkg] = "Using ubuntu toolchain"
PNBLACKLIST[orc] = "Using ubuntu toolchain"
PNBLACKLIST[packagegroup-core-device-devel] = "Using ubuntu toolchain"
PNBLACKLIST[patch] = "Using ubuntu toolchain"
PNBLACKLIST[patchelf] = "Using ubuntu toolchain"
PNBLACKLIST[liberror-perl] = "Using ubuntu toolchain"
PNBLACKLIST[libtest-needs-perl] = "Using ubuntu toolchain"
PNBLACKLIST[liburi-perl] = "Using ubuntu toolchain"
PNBLACKLIST[libxml-parser-perl] = "Using ubuntu toolchain"
PNBLACKLIST[libxml-perl] = "Using ubuntu toolchain"
PNBLACKLIST[libxml-simple-perl] = "Using ubuntu toolchain"
PNBLACKLIST[pkgconf] = "Using ubuntu toolchain"
PNBLACKLIST[prelink] = "Using ubuntu toolchain"
PNBLACKLIST[pseudo] = "Using ubuntu toolchain"
PNBLACKLIST[python-numpy] = "Using ubuntu toolchain"
PNBLACKLIST[python3-numpy] = "Using ubuntu toolchain"
PNBLACKLIST[python-nose] = "Using ubuntu toolchain"
PNBLACKLIST[python-scons] = "Using ubuntu toolchain"
PNBLACKLIST[python-setuptools] = "Using ubuntu toolchain"
PNBLACKLIST[python3-async] = "Using ubuntu toolchain"
PNBLACKLIST[python3-dbus] = "Using ubuntu toolchain"
PNBLACKLIST[python3-docutils] = "Using ubuntu toolchain"
PNBLACKLIST[python3-extras] = "Using ubuntu toolchain"
PNBLACKLIST[python3-git] = "Using ubuntu toolchain"
PNBLACKLIST[python3-gitdb] = "Using ubuntu toolchain"
PNBLACKLIST[python3-iniparse] = "Using ubuntu toolchain"
PNBLACKLIST[python3-mako] = "Using ubuntu toolchain"
PNBLACKLIST[python3-nose] = "Using ubuntu toolchain"
PNBLACKLIST[python3-pbr] = "Using ubuntu toolchain"
PNBLACKLIST[python3-pip] = "Using ubuntu toolchain"
PNBLACKLIST[python3-pycairo] = "Using ubuntu toolchain"
PNBLACKLIST[python3-pygobject] = "Using ubuntu toolchain"
PNBLACKLIST[python3-setuptools] = "Using ubuntu toolchain"
PNBLACKLIST[python3-six] = "Using ubuntu toolchain"
PNBLACKLIST[python3-smmap] = "Using ubuntu toolchain"
PNBLACKLIST[python3-subunit] = "Using ubuntu toolchain"
PNBLACKLIST[python3-testtools] = "Using ubuntu toolchain"
PNBLACKLIST[qemu] = "Using ubuntu toolchain"
PNBLACKLIST[qemuwrapper-cross] = "Using ubuntu toolchain"
PNBLACKLIST[quilt] = "Using ubuntu toolchain"
PNBLACKLIST[rpm] = "Using ubuntu toolchain"
PNBLACKLIST[rsync] = "Using ubuntu toolchain"
PNBLACKLIST[ruby] = "Using ubuntu toolchain"
PNBLACKLIST[squashfs-tools] = "Using ubuntu toolchain"
PNBLACKLIST[strace] = "Using ubuntu toolchain"
PNBLACKLIST[subversion] = "Using ubuntu toolchain"
PNBLACKLIST[swig] = "Using ubuntu toolchain"
PNBLACKLIST[syslinux] = "Using ubuntu toolchain"
PNBLACKLIST[systemd-bootchart] = "Using ubuntu toolchain"
PNBLACKLIST[tcf-agent] = "Using ubuntu toolchain"
PNBLACKLIST[tcl] = "Using ubuntu toolchain"
PNBLACKLIST[unfs3] = "Using ubuntu toolchain"
PNBLACKLIST[unifdef] = "Using ubuntu toolchain"
PNBLACKLIST[vala] = "Using ubuntu toolchain"
PNBLACKLIST[valgrind] = "Using ubuntu toolchain"
PNBLACKLIST[xmlto] = "Using ubuntu toolchain"
PNBLACKLIST[libunistring] = "Using ubuntu toolchain"
# recipes-graphics
PNBLACKLIST[builder] = "Using ubuntu toolchain"
PNBLACKLIST[cantarell-fonts] = "Using ubuntu toolchain"
PNBLACKLIST[clutter-1.0] = "Using ubuntu toolchain"
PNBLACKLIST[clutter-gst-3.0] = "Using ubuntu toolchain"
PNBLACKLIST[clutter-gtk-1.0] = "Using ubuntu toolchain"
PNBLACKLIST[cogl-1.0] = "Using ubuntu toolchain"
#PNBLACKLIST[libdrm] = "Using ubuntu toolchain"
PNBLACKLIST[eglinfo-fb] = "Using ubuntu toolchain"
PNBLACKLIST[eglinfo-x11] = "Using ubuntu toolchain"
PNBLACKLIST[fontconfig] = "Using ubuntu toolchain"
PNBLACKLIST[freetype] = "Using ubuntu toolchain"
PNBLACKLIST[glew] = "Using ubuntu toolchain"
PNBLACKLIST[harfbuzz] = "Using ubuntu toolchain"
PNBLACKLIST[core-image-clutter] = "Using ubuntu toolchain"
PNBLACKLIST[core-image-weston] = "Using ubuntu toolchain"
PNBLACKLIST[core-image-x11] = "Using ubuntu toolchain"
PNBLACKLIST[libjpeg-turbo] = "Using ubuntu toolchain"
PNBLACKLIST[kmscube] = "Using ubuntu toolchain"
PNBLACKLIST[libepoxy] = "Using ubuntu toolchain"
PNBLACKLIST[libfakekey] = "Using ubuntu toolchain"
PNBLACKLIST[libmatchbox] = "Using ubuntu toolchain"
PNBLACKLIST[libsdl] = "Using ubuntu toolchain"
PNBLACKLIST[libsdl2] = "Using ubuntu toolchain"
PNBLACKLIST[libva-utils] = "Using ubuntu toolchain"
PNBLACKLIST[libva] = "Using ubuntu toolchain"
PNBLACKLIST[matchbox-session] = "Using ubuntu toolchain"
PNBLACKLIST[matchbox-wm] = "Using ubuntu toolchain"
PNBLACKLIST[menu-cache] = "Using ubuntu toolchain"
PNBLACKLIST[libglu] = "Using ubuntu toolchain"
PNBLACKLIST[mesa-demos] = "Using ubuntu toolchain"
PNBLACKLIST[mesa-gl] = "Using ubuntu toolchain"
PNBLACKLIST[mesa] = "Using ubuntu toolchain"
PNBLACKLIST[mini-x-session] = "Using ubuntu toolchain"
PNBLACKLIST[mx-1.0] = "Using ubuntu toolchain"
PNBLACKLIST[packagegroup-core-clutter] = "Using ubuntu toolchain"
PNBLACKLIST[packagegroup-core-x11-base] = "Using ubuntu toolchain"
PNBLACKLIST[packagegroup-core-x11-xserver] = "Using ubuntu toolchain"
PNBLACKLIST[packagegroup-core-x11] = "Using ubuntu toolchain"
PNBLACKLIST[piglit] = "Using ubuntu toolchain"
PNBLACKLIST[pong-clock] = "Using ubuntu toolchain"
PNBLACKLIST[startup-notification] = "Using ubuntu toolchain"
PNBLACKLIST[liberation-fonts] = "Using ubuntu toolchain"
PNBLACKLIST[ttf-bitstream-vera] = "Using ubuntu toolchain"
PNBLACKLIST[assimp] = "Using ubuntu toolchain"
PNBLACKLIST[vulkan-demos] = "Using ubuntu toolchain"
PNBLACKLIST[vulkan] = "Using ubuntu toolchain"
PNBLACKLIST[waffle] = "Using ubuntu toolchain"
PNBLACKLIST[libinput] = "Using ubuntu toolchain"
PNBLACKLIST[mtdev] = "Using ubuntu toolchain"
PNBLACKLIST[xserver-nodm-init] = "Using ubuntu toolchain"
PNBLACKLIST[xcursor-transparent-theme] = "Using ubuntu toolchain"
PNBLACKLIST[pointercal-xinput] = "Using ubuntu toolchain"
PNBLACKLIST[xinput-calibrator] = "Using ubuntu toolchain"
PNBLACKLIST[mkfontdir] = "Using ubuntu toolchain"
PNBLACKLIST[mkfontscale] = "Using ubuntu toolchain"
PNBLACKLIST[rgb] = "Using ubuntu toolchain"
PNBLACKLIST[x11perf] = "Using ubuntu toolchain"
PNBLACKLIST[xauth] = "Using ubuntu toolchain"
PNBLACKLIST[xdpyinfo] = "Using ubuntu toolchain"
PNBLACKLIST[xev] = "Using ubuntu toolchain"
PNBLACKLIST[xeyes] = "Using ubuntu toolchain"
PNBLACKLIST[xhost] = "Using ubuntu toolchain"
PNBLACKLIST[xinit] = "Using ubuntu toolchain"
PNBLACKLIST[xinput] = "Using ubuntu toolchain"
PNBLACKLIST[xkbcomp] = "Using ubuntu toolchain"
PNBLACKLIST[xmodmap] = "Using ubuntu toolchain"
PNBLACKLIST[xprop] = "Using ubuntu toolchain"
PNBLACKLIST[xrandr] = "Using ubuntu toolchain"
PNBLACKLIST[xset] = "Using ubuntu toolchain"
PNBLACKLIST[xvinfo] = "Using ubuntu toolchain"
PNBLACKLIST[xwininfo] = "Using ubuntu toolchain"
PNBLACKLIST[xf86-input-evdev] = "Using ubuntu toolchain"
PNBLACKLIST[xf86-input-keyboard] = "Using ubuntu toolchain"
PNBLACKLIST[xf86-input-libinput] = "Using ubuntu toolchain"
PNBLACKLIST[xf86-input-mouse] = "Using ubuntu toolchain"
PNBLACKLIST[xf86-input-synaptics] = "Using ubuntu toolchain"
PNBLACKLIST[xf86-input-vmmouse] = "Using ubuntu toolchain"
PNBLACKLIST[xf86-video-cirrus] = "Using ubuntu toolchain"
PNBLACKLIST[xf86-video-fbdev] = "Using ubuntu toolchain"
PNBLACKLIST[xf86-video-intel] = "Using ubuntu toolchain"
PNBLACKLIST[xf86-video-vesa] = "Using ubuntu toolchain"
PNBLACKLIST[xf86-video-vmware] = "Using ubuntu toolchain"
PNBLACKLIST[encodings] = "Using ubuntu toolchain"
PNBLACKLIST[font-alias] = "Using ubuntu toolchain"
PNBLACKLIST[font-util] = "Using ubuntu toolchain"
PNBLACKLIST[xorg-minimal-fonts] = "Using ubuntu toolchain"
PNBLACKLIST[libdmx] = "Using ubuntu toolchain"
PNBLACKLIST[libfontenc] = "Using ubuntu toolchain"
PNBLACKLIST[libice] = "Using ubuntu toolchain"
PNBLACKLIST[libpciaccess] = "Using ubuntu toolchain"
PNBLACKLIST[libpthread-stubs] = "Using ubuntu toolchain"
PNBLACKLIST[libsm] = "Using ubuntu toolchain"
PNBLACKLIST[libx11-diet] = "Using ubuntu toolchain"
PNBLACKLIST[libxau] = "Using ubuntu toolchain"
PNBLACKLIST[libxcomposite] = "Using ubuntu toolchain"
PNBLACKLIST[libxcursor] = "Using ubuntu toolchain"
PNBLACKLIST[libxdamage] = "Using ubuntu toolchain"
PNBLACKLIST[libxdmcp] = "Using ubuntu toolchain"
PNBLACKLIST[libxext] = "Using ubuntu toolchain"
PNBLACKLIST[libxfixes] = "Using ubuntu toolchain"
PNBLACKLIST[libxfont2] = "Using ubuntu toolchain"
PNBLACKLIST[libxfont] = "Using ubuntu toolchain"
PNBLACKLIST[libxft] = "Using ubuntu toolchain"
PNBLACKLIST[libxi] = "Using ubuntu toolchain"
PNBLACKLIST[libxinerama] = "Using ubuntu toolchain"
PNBLACKLIST[libxkbcommon] = "Using ubuntu toolchain"
PNBLACKLIST[libxkbfile] = "Using ubuntu toolchain"
PNBLACKLIST[libxmu] = "Using ubuntu toolchain"
PNBLACKLIST[libxpm] = "Using ubuntu toolchain"
PNBLACKLIST[libxrandr] = "Using ubuntu toolchain"
PNBLACKLIST[libxrender] = "Using ubuntu toolchain"
PNBLACKLIST[libxres] = "Using ubuntu toolchain"
PNBLACKLIST[libxscrnsaver] = "Using ubuntu toolchain"
PNBLACKLIST[libxshmfence] = "Using ubuntu toolchain"
PNBLACKLIST[libxt] = "Using ubuntu toolchain"
PNBLACKLIST[libxtst] = "Using ubuntu toolchain"
PNBLACKLIST[libxv] = "Using ubuntu toolchain"
PNBLACKLIST[libxvmc] = "Using ubuntu toolchain"
PNBLACKLIST[libxxf86dga] = "Using ubuntu toolchain"
PNBLACKLIST[libxxf86misc] = "Using ubuntu toolchain"
PNBLACKLIST[libxxf86vm] = "Using ubuntu toolchain"
PNBLACKLIST[pixman] = "Using ubuntu toolchain"
PNBLACKLIST[xcb-util-image] = "Using ubuntu toolchain"
PNBLACKLIST[xcb-util-keysyms] = "Using ubuntu toolchain"
PNBLACKLIST[xcb-util-renderutil] = "Using ubuntu toolchain"
PNBLACKLIST[xcb-util-wm] = "Using ubuntu toolchain"
PNBLACKLIST[xcb-util] = "Using ubuntu toolchain"
PNBLACKLIST[xkeyboard-config] = "Using ubuntu toolchain"
PNBLACKLIST[xtrans] = "Using ubuntu toolchain"
PNBLACKLIST[xcb-proto] = "Using ubuntu toolchain"
PNBLACKLIST[xorgproto] = "Using ubuntu toolchain"
PNBLACKLIST[makedepend] = "Using ubuntu toolchain"
PNBLACKLIST[util-macros] = "Using ubuntu toolchain"
PNBLACKLIST[xserver-xf86-config] = "Using ubuntu toolchain"
PNBLACKLIST[xserver-xorg] = "Using ubuntu toolchain"
PNBLACKLIST[xrestop] = "Using ubuntu toolchain"
PNBLACKLIST[xvideo-tests] = "Using ubuntu toolchain"
# recipes-rt
PNBLACKLIST[core-image-rt-sdk] = "Using ubuntu toolchain"
PNBLACKLIST[core-image-rt] = "Using ubuntu toolchain"
PNBLACKLIST[hwlatdetect] = "Using ubuntu toolchain"
PNBLACKLIST[rt-tests] = "Using ubuntu toolchain"
# recipes-connectivity
PNBLACKLIST[avahi-ui] = "Using ubuntu toolchain"
PNBLACKLIST[avahi] = "Using ubuntu toolchain"
PNBLACKLIST[bind] = "Using ubuntu toolchain"
PNBLACKLIST[bluez5] = "Using ubuntu toolchain"
PNBLACKLIST[connman-conf] = "Using ubuntu toolchain"
PNBLACKLIST[connman-gnome] = "Using ubuntu toolchain"
PNBLACKLIST[connman] = "Using ubuntu toolchain"
PNBLACKLIST[dhcp] = "Using ubuntu toolchain"
PNBLACKLIST[iproute2] = "Using ubuntu toolchain"
PNBLACKLIST[irda-utils] = "Using ubuntu toolchain"
PNBLACKLIST[libnss-mdns] = "Using ubuntu toolchain"
PNBLACKLIST[libpcap] = "Using ubuntu toolchain"
PNBLACKLIST[mobile-broadband-provider-info] = "Using ubuntu toolchain"
PNBLACKLIST[neard] = "Using ubuntu toolchain"
PNBLACKLIST[nfs-utils] = "Using ubuntu toolchain"
PNBLACKLIST[ofono] = "Using ubuntu toolchain"
PNBLACKLIST[openssh] = "Using ubuntu toolchain"
PNBLACKLIST[openssl10] = "Using ubuntu toolchain"
PNBLACKLIST[openssl] = "Using ubuntu toolchain"
PNBLACKLIST[ppp-dialin] = "Using ubuntu toolchain"
PNBLACKLIST[ppp] = "Using ubuntu toolchain"
PNBLACKLIST[resolvconf] = "Using ubuntu toolchain"
PNBLACKLIST[socat] = "Using ubuntu toolchain"
PNBLACKLIST[wpa-supplicant] = "Using ubuntu toolchain"
PNBLACKLIST[krb5] = "Using ubuntu toolchain"
# recipes-extended
PNBLACKLIST[acpica] = "Using ubuntu toolchain"
PNBLACKLIST[asciidoc] = "Using ubuntu toolchain"
PNBLACKLIST[at] = "Using ubuntu toolchain"
PNBLACKLIST[bc] = "Using ubuntu toolchain"
PNBLACKLIST[blktool] = "Using ubuntu toolchain"
PNBLACKLIST[bzip2] = "Using bzip2-ubuntu"
PNBLACKLIST[chkconfig] = "Using ubuntu toolchain"
PNBLACKLIST[cpio] = "Using ubuntu toolchain"
PNBLACKLIST[cracklib] = "Using ubuntu toolchain"
PNBLACKLIST[cronie] = "Using ubuntu toolchain"
PNBLACKLIST[cups] = "Using ubuntu toolchain"
PNBLACKLIST[cwautomacros] = "Using ubuntu toolchain"
PNBLACKLIST[diffutils] = "Using ubuntu toolchain"
PNBLACKLIST[ed] = "Using ubuntu toolchain"
PNBLACKLIST[ethtool] = "Using ubuntu toolchain"
PNBLACKLIST[findutils] = "Using ubuntu toolchain"
PNBLACKLIST[foomatic-filters] = "Using ubuntu toolchain"
PNBLACKLIST[gawk] = "Using ubuntu toolchain"
PNBLACKLIST[ghostscript] = "Using ubuntu toolchain"
PNBLACKLIST[go-helloworld] = "Using ubuntu toolchain"
PNBLACKLIST[gperf] = "Using ubuntu toolchain"
PNBLACKLIST[grep] = "Using ubuntu toolchain"
PNBLACKLIST[groff] = "Using ubuntu toolchain"
PNBLACKLIST[gzip] = "Using ubuntu toolchain"
PNBLACKLIST[hdparm] = "Using ubuntu toolchain"
PNBLACKLIST[core-image-full-cmdline] = "Using ubuntu toolchain"
PNBLACKLIST[core-image-kernel-dev] = "Using ubuntu toolchain"
PNBLACKLIST[core-image-lsb-dev] = "Using ubuntu toolchain"
PNBLACKLIST[core-image-lsb-sdk] = "Using ubuntu toolchain"
PNBLACKLIST[core-image-lsb] = "Using ubuntu toolchain"
PNBLACKLIST[core-image-testmaster-initramfs] = "Using ubuntu toolchain"
PNBLACKLIST[core-image-testmaster] = "Using ubuntu toolchain"
PNBLACKLIST[iptables] = "Using ubuntu toolchain"
PNBLACKLIST[iputils] = "Using ubuntu toolchain"
PNBLACKLIST[less] = "Using ubuntu toolchain"
PNBLACKLIST[libaio] = "Using ubuntu toolchain"
PNBLACKLIST[libarchive] = "Using ubuntu toolchain"
PNBLACKLIST[libidn] = "Using ubuntu toolchain"
PNBLACKLIST[libmnl] = "Using ubuntu toolchain"
PNBLACKLIST[libnsl2] = "Using ubuntu toolchain"
PNBLACKLIST[libnss-nis] = "Using ubuntu toolchain"
PNBLACKLIST[libpipeline] = "Using ubuntu toolchain"
PNBLACKLIST[libsolv] = "Using ubuntu toolchain"
PNBLACKLIST[libtirpc] = "Using ubuntu toolchain"
PNBLACKLIST[lighttpd] = "Using ubuntu toolchain"
PNBLACKLIST[logrotate] = "Using ubuntu toolchain"
PNBLACKLIST[lsb] = "Using ubuntu toolchain"
PNBLACKLIST[lsbinitscripts] = "Using ubuntu toolchain"
PNBLACKLIST[lsbtest] = "Using ubuntu toolchain"
PNBLACKLIST[lsof] = "Using ubuntu toolchain"
PNBLACKLIST[ltp] = "Using ubuntu toolchain"
PNBLACKLIST[lzip] = "Using ubuntu toolchain"
PNBLACKLIST[man-db] = "Using ubuntu toolchain"
PNBLACKLIST[man-pages] = "Using ubuntu toolchain"
PNBLACKLIST[mc] = "Using ubuntu toolchain"
PNBLACKLIST[mdadm] = "Using ubuntu toolchain"
PNBLACKLIST[mingetty] = "Using ubuntu toolchain"
PNBLACKLIST[minicom] = "Using ubuntu toolchain"
PNBLACKLIST[msmtp] = "Using ubuntu toolchain"
PNBLACKLIST[net-tools] = "Using ubuntu toolchain"
PNBLACKLIST[libnewt-python] = "Using ubuntu toolchain"
PNBLACKLIST[packagegroup-core-full-cmdline] = "Using ubuntu toolchain"
PNBLACKLIST[packagegroup-core-lsb] = "Using ubuntu toolchain"
PNBLACKLIST[libpam] = "Using ubuntu toolchain"
PNBLACKLIST[parted] = "Using ubuntu toolchain"
PNBLACKLIST[pbzip2] = "Using ubuntu toolchain"
PNBLACKLIST[libconvert-asn1-perl] = "Using ubuntu toolchain"
PNBLACKLIST[libtimedate-perl] = "Using ubuntu toolchain"
PNBLACKLIST[libxml-namespacesupport-perl] = "Using ubuntu toolchain"
PNBLACKLIST[libxml-sax-base-perl] = "Using ubuntu toolchain"
PNBLACKLIST[libxml-sax-perl] = "Using ubuntu toolchain"
PNBLACKLIST[pigz] = "Using ubuntu toolchain"
PNBLACKLIST[procps] = "Using ubuntu toolchain"
PNBLACKLIST[psmisc] = "Using ubuntu toolchain"
PNBLACKLIST[quota] = "Using ubuntu toolchain"
PNBLACKLIST[rpcbind] = "Using ubuntu toolchain"
PNBLACKLIST[rpcsvc-proto] = "Using ubuntu toolchain"
PNBLACKLIST[screen] = "Using ubuntu toolchain"
PNBLACKLIST[sed] = "Using ubuntu toolchain"
PNBLACKLIST[shadow-securetty] = "Using ubuntu toolchain"
PNBLACKLIST[shadow] = "Using ubuntu toolchain"
PNBLACKLIST[stress] = "Using ubuntu toolchain"
PNBLACKLIST[sudo] = "Using ubuntu toolchain"
PNBLACKLIST[sysklogd] = "Using ubuntu toolchain"
PNBLACKLIST[sysstat] = "Using ubuntu toolchain"
PNBLACKLIST[tar] = "Using ubuntu toolchain"
PNBLACKLIST[tcp-wrappers] = "Using ubuntu toolchain"
PNBLACKLIST[texi2html] = "Using ubuntu toolchain"
PNBLACKLIST[texinfo] = "Using ubuntu toolchain"
PNBLACKLIST[time] = "Using ubuntu toolchain"
PNBLACKLIST[tzdata] = "Using ubuntu toolchain"
PNBLACKLIST[unzip] = "Using ubuntu toolchain"
PNBLACKLIST[watchdog-config] = "Using ubuntu toolchain"
PNBLACKLIST[watchdog] = "Using ubuntu toolchain"
PNBLACKLIST[wget] = "Using ubuntu toolchain"
PNBLACKLIST[which] = "Using ubuntu toolchain"
PNBLACKLIST[xdg-utils] = "Using ubuntu toolchain"
PNBLACKLIST[xinetd] = "Using ubuntu toolchain"
PNBLACKLIST[xz] = "Using ubuntu toolchain"
PNBLACKLIST[zip] = "Using ubuntu toolchain"
# recipes-kernel
PNBLACKLIST[blktrace] = "Using ubuntu toolchain"
PNBLACKLIST[cryptodev-linux] = "Using ubuntu toolchain"
PNBLACKLIST[cryptodev-module] = "Using ubuntu toolchain"
PNBLACKLIST[cryptodev-tests] = "Using ubuntu toolchain"
PNBLACKLIST[dtc] = "Using ubuntu toolchain"
PNBLACKLIST[kexec-tools] = "Using ubuntu toolchain"
PNBLACKLIST[kmod] = "Using ubuntu toolchain"
PNBLACKLIST[linux-firmware] = "Using ubuntu toolchain"
PNBLACKLIST[linux-libc-headers] = "Using linux-libc-headers-ubuntu"
PNBLACKLIST[kernel-devsrc] = "Using ubuntu toolchain"
PNBLACKLIST[linux-dummy] = "Using ubuntu toolchain"
PNBLACKLIST[linux-yocto-dev] = "Using ubuntu toolchain"
PNBLACKLIST[linux-yocto-rt] = "Using ubuntu toolchain"
PNBLACKLIST[linux-yocto-rt] = "Using ubuntu toolchain"
PNBLACKLIST[linux-yocto-tiny] = "Using ubuntu toolchain"
PNBLACKLIST[linux-yocto-tiny] = "Using ubuntu toolchain"
PNBLACKLIST[linux-yocto] = "Using ubuntu toolchain"
PNBLACKLIST[linux-yocto] = "Using ubuntu toolchain"
PNBLACKLIST[babeltrace] = "Using ubuntu toolchain"
PNBLACKLIST[lttng-modules] = "Using ubuntu toolchain"
PNBLACKLIST[lttng-tools] = "Using ubuntu toolchain"
PNBLACKLIST[lttng-ust] = "Using ubuntu toolchain"
PNBLACKLIST[modutils-initscripts] = "Using ubuntu toolchain"
PNBLACKLIST[powertop] = "Using ubuntu toolchain"
PNBLACKLIST[sysprof] = "Using ubuntu toolchain"
PNBLACKLIST[systemtap-uprobes] = "Using ubuntu toolchain"
PNBLACKLIST[systemtap] = "Using ubuntu toolchain"
# recipes-sato
PNBLACKLIST[core-image-sato-dev] = "Using ubuntu toolchain"
PNBLACKLIST[core-image-sato-sdk-ptest] = "Using ubuntu toolchain"
PNBLACKLIST[core-image-sato-sdk] = "Using ubuntu toolchain"
PNBLACKLIST[core-image-sato] = "Using ubuntu toolchain"
PNBLACKLIST[l3afpad] = "Using ubuntu toolchain"
PNBLACKLIST[matchbox-config-gtk] = "Using ubuntu toolchain"
PNBLACKLIST[matchbox-desktop] = "Using ubuntu toolchain"
PNBLACKLIST[matchbox-keyboard] = "Using ubuntu toolchain"
PNBLACKLIST[matchbox-panel-2] = "Using ubuntu toolchain"
PNBLACKLIST[matchbox-session-sato] = "Using ubuntu toolchain"
PNBLACKLIST[matchbox-terminal] = "Using ubuntu toolchain"
PNBLACKLIST[matchbox-theme-sato] = "Using ubuntu toolchain"
PNBLACKLIST[packagegroup-core-x11-sato] = "Using ubuntu toolchain"
PNBLACKLIST[pcmanfm] = "Using ubuntu toolchain"
PNBLACKLIST[pulseaudio-client-conf-sato] = "Using ubuntu toolchain"
PNBLACKLIST[puzzles] = "Using ubuntu toolchain"
PNBLACKLIST[rxvt-unicode] = "Using ubuntu toolchain"
PNBLACKLIST[sato-screenshot] = "Using ubuntu toolchain"
PNBLACKLIST[settings-daemon] = "Using ubuntu toolchain"
PNBLACKLIST[shutdown-desktop] = "Using ubuntu toolchain"
PNBLACKLIST[webkitgtk] = "Using ubuntu toolchain"
# recipes-core
PNBLACKLIST[busybox-inittab] = "Using ubuntu toolchain"
PNBLACKLIST[busybox] = "Using ubuntu toolchain"
PNBLACKLIST[console-tools] = "Using ubuntu toolchain"
PNBLACKLIST[coreutils] = "Using ubuntu toolchain"
PNBLACKLIST[dbus-wait] = "Using ubuntu toolchain"
PNBLACKLIST[dbus-glib] = "Using ubuntu toolchain"
PNBLACKLIST[dbus-test] = "Using ubuntu toolchain"
PNBLACKLIST[dbus] = "Using dbus-ubuntu"
PNBLACKLIST[dropbear] = "Using ubuntu toolchain"
PNBLACKLIST[expat] = "Using ubuntu toolchain"
PNBLACKLIST[fts] = "Using ubuntu toolchain"
PNBLACKLIST[gettext] = "Using ubuntu toolchain"
PNBLACKLIST[glib-2.0] = "Using glib-2.0-ubuntu"
PNBLACKLIST[glibc-locale] = "Using glibc-ubuntu"
PNBLACKLIST[glibc-mtrace] = "Using glibc-ubuntu"
PNBLACKLIST[glibc-scripts] = "Using glibc-ubuntu"
PNBLACKLIST[glibc] = "Using glibc-ubuntu"
PNBLACKLIST[ifupdown] = "Using ubuntu toolchain"
PNBLACKLIST[kbd] = "Using ubuntu toolchain"
PNBLACKLIST[libcgroup] = "Using ubuntu toolchain"
PNBLACKLIST[libxcrypt] = "Using libxcrypt-ubuntu"
PNBLACKLIST[libxml2] = "Using ubuntu toolchain"
PNBLACKLIST[meta-environment-extsdk] = "Using ubuntu toolchain"
PNBLACKLIST[meta-environment] = "Using ubuntu toolchain"
PNBLACKLIST[meta-go-toolchain] = "Using ubuntu toolchain"
PNBLACKLIST[meta-ide-support] = "Using ubuntu toolchain"
PNBLACKLIST[meta-toolchain] = "Using ubuntu toolchain"
PNBLACKLIST[meta-world-pkgdata] = "Using ubuntu toolchain"
PNBLACKLIST[package-index] = "Using ubuntu toolchain"
PNBLACKLIST[signing-keys] = "Using ubuntu toolchain"
PNBLACKLIST[testexport-tarball] = "Using ubuntu toolchain"
PNBLACKLIST[wic-tools] = "Using ubuntu toolchain"
PNBLACKLIST[bsd-headers] = "Using ubuntu toolchain"
PNBLACKLIST[libssp-nonshared] = "Using ubuntu toolchain"
PNBLACKLIST[musl-utils] = "Using ubuntu toolchain"
PNBLACKLIST[musl] = "Using ubuntu toolchain"
PNBLACKLIST[ncurses] = "Using ncurses-ubuntu"
PNBLACKLIST[netbase] = "Using ubuntu toolchain"
PNBLACKLIST[libgloss] = "Using ubuntu toolchain"
PNBLACKLIST[newlib] = "Using ubuntu toolchain"
PNBLACKLIST[os-release] = "Using ubuntu toolchain"
PNBLACKLIST[ovmf-shell-image] = "Using ubuntu toolchain"
PNBLACKLIST[ovmf] = "Using ubuntu toolchain"
PNBLACKLIST[packagegroup-base] = "Using ubuntu toolchain"
PNBLACKLIST[packagegroup-core-boot] = "Using ubuntu toolchain"
PNBLACKLIST[packagegroup-core-buildessential] = "Using ubuntu toolchain"
PNBLACKLIST[packagegroup-core-eclipse-debug] = "Using ubuntu toolchain"
PNBLACKLIST[packagegroup-core-nfs] = "Using ubuntu toolchain"
PNBLACKLIST[packagegroup-core-sdk] = "Using ubuntu toolchain"
PNBLACKLIST[packagegroup-core-ssh-dropbear] = "Using ubuntu toolchain"
PNBLACKLIST[packagegroup-core-ssh-openssh] = "Using ubuntu toolchain"
PNBLACKLIST[packagegroup-core-tools-debug] = "Using ubuntu toolchain"
PNBLACKLIST[packagegroup-core-tools-profile] = "Using ubuntu toolchain"
PNBLACKLIST[packagegroup-core-tools-testapps] = "Using ubuntu toolchain"
PNBLACKLIST[packagegroup-cross-canadian] = "Using ubuntu toolchain"
PNBLACKLIST[packagegroup-go-cross-canadian] = "Using ubuntu toolchain"
PNBLACKLIST[packagegroup-go-sdk-target] = "Using ubuntu toolchain"
PNBLACKLIST[packagegroup-self-hosted] = "Using ubuntu toolchain"
PNBLACKLIST[psplash] = "Using ubuntu toolchain"
PNBLACKLIST[sysfsutils] = "Using ubuntu toolchain"
PNBLACKLIST[systemd-boot] = "Using ubuntu toolchain"
PNBLACKLIST[systemd-bootconf] = "Using ubuntu toolchain"
PNBLACKLIST[systemd-compat-units] = "Using ubuntu toolchain"
PNBLACKLIST[systemd-conf] = "Using ubuntu toolchain"
PNBLACKLIST[systemd-serialgetty] = "Using ubuntu toolchain"
PNBLACKLIST[systemd] = "Using ubuntu toolchain"
PNBLACKLIST[sysvinit-inittab] = "Using ubuntu toolchain"
PNBLACKLIST[sysvinit] = "Using ubuntu toolchain"
PNBLACKLIST[eudev] = "Using ubuntu toolchain"
PNBLACKLIST[udev-extraconf] = "Using ubuntu toolchain"
PNBLACKLIST[util-linux] = "Using util-linux-ubuntu"
PNBLACKLIST[update-rc.d] = "Using ubuntu toolchain"
#PNBLACKLIST[volatile-binds] = "Using ubuntu toolchain"
PNBLACKLIST[zlib] = "Using zlib-ubuntu"
# recipes-gnome
PNBLACKLIST[epiphany] = "Using ubuntu toolchain"
PNBLACKLIST[gcr] = "Using ubuntu toolchain"
PNBLACKLIST[gdk-pixbuf] = "Using ubuntu toolchain"
PNBLACKLIST[adwaita-icon-theme] = "Using ubuntu toolchain"
PNBLACKLIST[gconf] = "Using ubuntu toolchain"
PNBLACKLIST[gnome-themes-standard] = "Using ubuntu toolchain"
PNBLACKLIST[libart-lgpl] = "Using ubuntu toolchain"
PNBLACKLIST[gsettings-desktop-schemas] = "Using ubuntu toolchain"
PNBLACKLIST[gtk+3] = "Using ubuntu toolchain"
PNBLACKLIST[gtk+] = "Using ubuntu toolchain"
PNBLACKLIST[gtk-doc] = "Using ubuntu toolchain"
PNBLACKLIST[hicolor-icon-theme] = "Using ubuntu toolchain"
PNBLACKLIST[json-glib] = "Using ubuntu toolchain"
PNBLACKLIST[libgudev] = "Using ubuntu toolchain"
PNBLACKLIST[libnotify] = "Using ubuntu toolchain"
PNBLACKLIST[librsvg] = "Using ubuntu toolchain"
PNBLACKLIST[libsecret] = "Using ubuntu toolchain"
# recipes-multimedia
PNBLACKLIST[alsa-lib] = "Using ubuntu toolchain"
PNBLACKLIST[alsa-plugins] = "Using ubuntu toolchain"
PNBLACKLIST[alsa-tools] = "Using ubuntu toolchain"
PNBLACKLIST[alsa-utils-scripts] = "Using ubuntu toolchain"
PNBLACKLIST[alsa-utils] = "Using ubuntu toolchain"
PNBLACKLIST[ffmpeg] = "Using ubuntu toolchain"
PNBLACKLIST[flac] = "Using ubuntu toolchain"
PNBLACKLIST[gst-examples] = "Using ubuntu toolchain"
PNBLACKLIST[gst-validate] = "Using ubuntu toolchain"
PNBLACKLIST[gstreamer1.0-libav] = "Using ubuntu toolchain"
PNBLACKLIST[gstreamer1.0-meta-base] = "Using ubuntu toolchain"
PNBLACKLIST[gstreamer1.0-plugins-ugly] = "Using ubuntu toolchain"
PNBLACKLIST[gstreamer1.0-python] = "Using ubuntu toolchain"
PNBLACKLIST[gstreamer1.0-rtsp-server] = "Using gstreamer1.0-rtsp-server-ubuntu"
PNBLACKLIST[gstreamer1.0-vaapi] = "Using ubuntu toolchain"
PNBLACKLIST[gstreamer1.0] = "Using ubuntu toolchain"
PNBLACKLIST[binutils] = "Using ubuntu toolchain"
PNBLACKLIST[liba52] = "Using ubuntu toolchain"
PNBLACKLIST[libid3tag] = "Using ubuntu toolchain"
PNBLACKLIST[libogg] = "Using ubuntu toolchain"
PNBLACKLIST[libomxil] = "Using ubuntu toolchain"
PNBLACKLIST[libpng] = "Using ubuntu toolchain"
PNBLACKLIST[libsamplerate0] = "Using ubuntu toolchain"
PNBLACKLIST[libsndfile1] = "Using ubuntu toolchain"
PNBLACKLIST[libtheora] = "Using ubuntu toolchain"
PNBLACKLIST[tiff] = "Using ubuntu toolchain"
PNBLACKLIST[libvorbis] = "Using ubuntu toolchain"
PNBLACKLIST[mpg123] = "Using ubuntu toolchain"
PNBLACKLIST[sbc] = "Using ubuntu toolchain"
PNBLACKLIST[speexdsp] = "Using speexdsp-ubuntu"
PNBLACKLIST[speex] = "Using speex-ubuntu"
PNBLACKLIST[libwebp] = "Using ubuntu toolchain"
PNBLACKLIST[x264] = "Using ubuntu toolchain"
PNBLACKLIST[rtmpdump] = "Using ubuntu toolchain"
# recipes-support
PNBLACKLIST[apr-util] = "Using ubuntu toolchain"
PNBLACKLIST[apr] = "Using ubuntu toolchain"
PNBLACKLIST[argp-standalone] = "Using ubuntu toolchain"
PNBLACKLIST[aspell] = "Using ubuntu toolchain"
PNBLACKLIST[at-spi2-atk] = "Using ubuntu toolchain"
PNBLACKLIST[at-spi2-core] = "Using ubuntu toolchain"
PNBLACKLIST[atk] = "Using ubuntu toolchain"
PNBLACKLIST[acl] = "Using ubuntu toolchain"
PNBLACKLIST[attr] = "Using ubuntu toolchain"
PNBLACKLIST[bmap-tools] = "Using ubuntu toolchain"
PNBLACKLIST[boost] = "Using ubuntu toolchain"
PNBLACKLIST[consolekit] = "Using ubuntu toolchain"
PNBLACKLIST[curl] = "Using curl-ubuntu"
PNBLACKLIST[debianutils] = "Using ubuntu toolchain"
PNBLACKLIST[dos2unix] = "Using ubuntu toolchain"
PNBLACKLIST[enchant] = "Using ubuntu toolchain"
PNBLACKLIST[fribidi] = "Using ubuntu toolchain"
PNBLACKLIST[gnome-desktop-testing] = "Using ubuntu toolchain"
PNBLACKLIST[gnupg] = "Using ubuntu toolchain"
PNBLACKLIST[libtasn1] = "Using ubuntu toolchain"
PNBLACKLIST[gpgme] = "Using ubuntu toolchain"
PNBLACKLIST[icu] = "Using ubuntu toolchain"
PNBLACKLIST[iso-codes] = "Using ubuntu toolchain"
PNBLACKLIST[libassuan] = "Using ubuntu toolchain"
PNBLACKLIST[libatomic-ops] = "Using ubuntu toolchain"
PNBLACKLIST[libbsd] = "Using ubuntu toolchain"
PNBLACKLIST[libcap-ng] = "Using ubuntu toolchain"
PNBLACKLIST[libcap] = "Using ubuntu toolchain"
PNBLACKLIST[libcheck] = "Using ubuntu toolchain"
PNBLACKLIST[libcroco] = "Using ubuntu toolchain"
PNBLACKLIST[libdaemon] = "Using ubuntu toolchain"
PNBLACKLIST[libevdev] = "Using ubuntu toolchain"
PNBLACKLIST[libexif] = "Using ubuntu toolchain"
PNBLACKLIST[libffi] = "Using ubuntu toolchain"
PNBLACKLIST[libfm-extra] = "Using ubuntu toolchain"
PNBLACKLIST[libfm] = "Using ubuntu toolchain"
PNBLACKLIST[libgcrypt] = "Using ubuntu toolchain"
PNBLACKLIST[libgpg-error] = "Using ubuntu toolchain"
PNBLACKLIST[libical] = "Using ubuntu toolchain"
PNBLACKLIST[libksba] = "Using ubuntu toolchain"
PNBLACKLIST[libmpc] = "Using ubuntu toolchain"
PNBLACKLIST[libnl] = "Using ubuntu toolchain"
PNBLACKLIST[libpcre2] = "Using ubuntu toolchain"
PNBLACKLIST[libpcre] = "Using ubuntu toolchain"
PNBLACKLIST[libproxy] = "Using ubuntu toolchain"
PNBLACKLIST[libsoup-2.4] = "Using ubuntu toolchain"
PNBLACKLIST[liburcu] = "Using ubuntu toolchain"
PNBLACKLIST[libxslt] = "Using ubuntu toolchain"
PNBLACKLIST[libyaml] = "Using ubuntu toolchain"
PNBLACKLIST[lz4] = "Using ubuntu toolchain"
PNBLACKLIST[lzo] = "Using ubuntu toolchain"
PNBLACKLIST[lzop] = "Using ubuntu toolchain"
PNBLACKLIST[mpfr] = "Using ubuntu toolchain"
PNBLACKLIST[npth] = "Using ubuntu toolchain"
PNBLACKLIST[nspr] = "Using ubuntu toolchain"
PNBLACKLIST[nss-myhostname] = "Using ubuntu toolchain"
PNBLACKLIST[nss] = "Using ubuntu toolchain"
PNBLACKLIST[p11-kit] = "Using ubuntu toolchain"
PNBLACKLIST[pinentry] = "Using ubuntu toolchain"
PNBLACKLIST[ptest-runner] = "Using ubuntu toolchain"
PNBLACKLIST[re2c] = "Using ubuntu toolchain"
PNBLACKLIST[rng-tools] = "Using ubuntu toolchain"
PNBLACKLIST[serf] = "Using ubuntu toolchain"
PNBLACKLIST[shared-mime-info] = "Using ubuntu toolchain"
PNBLACKLIST[source-highlight] = "Using ubuntu toolchain"
PNBLACKLIST[sqlite3] = "Using ubuntu toolchain"
PNBLACKLIST[taglib] = "Using ubuntu toolchain"
PNBLACKLIST[xuser-account] = "Using ubuntu toolchain"
PNBLACKLIST[vte] = "Using ubuntu toolchain"
PNBLACKLIST[nghttp2] = "Using ubuntu toolchain"
PNBLACKLIST[gnutls] = "Using ubuntu toolchain"
PNBLACKLIST[nettle] = "Using ubuntu toolchain"
PNBLACKLIST[gmp] = "Using ubuntu toolchain"
PNBLACKLIST[p11-kit] = "Using ubuntu toolchain"
PNBLACKLIST[libtasn1] = "Using ubuntu toolchain"
PNBLACKLIST[sqlite3] = "Using ubuntu toolchain"
```
