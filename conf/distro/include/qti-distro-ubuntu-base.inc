## conf/distro/qti-distro-ubuntu-fullstack-debug.conf
```bitbake
#################################################################################################
#@TYPE Distribution
#@NAME qti-distro-ubuntu-fullstack-debug
#@DISCRIPTION:
#with debugging capabilities. Not optimized for performance
# Supported DISTROOVERRIDES are
#  * qti-distro-ubuntu-base            - provision for base distro variable overrides
#  * qti-distro-ubuntu-debug           - provision for debug distro variable overrides
#  * qit-distro-ubuntu-fullstack-debug - provision for fullstack-debug variable overrides
# For same variable override precedence order is
# qti-distro-ubuntu-fullstack-debug > qti-distro-ubuntu-debug > qti-distro-ubuntu-base
###################################################################################################
require ${COREBASE}/meta-qti-ubuntu/conf/distro/include/qti-distro-ubuntu-fullstack-base.inc

DISTRO_NAME = "QTI Ubuntu distro with fullstack debug capabilities"
DISTROOVERRIDES =. "qti-distro-ubuntu-fullstack-debug:"

CONSOLE_PARAM = "console=ttyMSM0,115200,n8"
KERNEL_CONFIG = "vendor/kona_defconfig"
SERIAL_CONSOLE = "115200 ttyMSM0"
LINUX_VERSION_EXTENSION = ""
```

## conf/distro/qti-distro-ubuntu-fullstack-perf.conf
```bitbake
#######################################################################
#@TYPE Distribution
#@NAME qti-distro-ubuntu-fullstack-perf
#@DISCRIPTION:
# with performance orientation.
# Supported DISTROOVERRIDES are
#  * qti-distro-ubuntu-base            - provision for base distro variable overrides
#  * qti-distro-ubuntu-perf            - provision for perf distro variable overrides
#  * qti-distro-ubuntu-fullstack-perf  - provision for perf distro variable overrides
# For same variable override precedence order is
# qti-distro-ubuntu-fullstack-perf > qti-distro-ubuntu-perf > qti-distro-ubuntu-base
#######################################################################
require ${COREBASE}/meta-qti-ubuntu/conf/distro/include/qti-distro-ubuntu-fullstack-base.inc

DISTRO_NAME = "QTI Ubuntu distro with fullstack perf capabilities"
DISTROOVERRIDES =. "qti-distro-ubuntu-fullstack-perf:"

#CONSOLE_PARAM = "console=ttyMSM0,115200,n8"
KERNEL_CONFIG_kona = "vendor/kona-qgki_defconfig"
#SERIAL_CONSOLE = "115200 ttyMSM0"
LINUX_VERSION_EXTENSION = "-perf"
```

## conf/distro/qti-distro-ubuntu-perf.conf
```bitbake
#######################################################################
#@TYPE Distribution
#@NAME qti-distro-ubuntu-perf
#@DISCRIPTION:
# with performance orientation.
# Supported DISTROOVERRIDES are
#  * qti-distro-ubuntu-base  - provision for base distro variable overrides
#  * qti-distro-ubuntu-perf  - provision for perf distro variable overrides
# For same variable override qti-distro-ubuntu-perf takes precedence over qti-distro-ubuntu-base.
#######################################################################
require ${COREBASE}/meta-qti-ubuntu/conf/distro/include/qti-distro-ubuntu-base.inc

DISTRO_NAME = "QTI Ubuntu distro with perf capabilities"
DISTROOVERRIDES =. "qti-distro-ubuntu-perf:"

#CONSOLE_PARAM = "console=ttyMSM0,115200,n8"
KERNEL_CONFIG = "vendor/kona-perf_defconfig"
#SERIAL_CONSOLE = "115200 ttyMSM0"

LINUX_VERSION_EXTENSION = "-perf"
```

## conf/layer.conf
```bitbake
BBFILES += "${@bb.utils.contains_any('DISTRO', 'qti-distro-ubuntu-debug qti-distro-ubuntu-fullstack-debug qti-distro-ubuntu-perf qti-distro-ubuntu-fullstack-perf',"${LAYERDIR}/recipes/*/*.bb ${LAYERDIR}/recipes/*/*.bbappend ${LAYERDIR}/recipes-*/*/*.bb ${LAYERDIR}/recipes-*/*/*.bbappend ${LAYERDIR}/recipes-products/images/*.bbappend ${LAYERDIR}/recipes-*/*/*/*.bb","${LAYERDIR}/recipes-toolchain/bbappends/edk2_%.bbappend ${LAYERDIR}/recipes-toolchain/bbappends/qcacld32-ll_git.bbappend ${LAYERDIR}/recipes-toolchain/bbappends/qti-robotics-image.bbappend ./recipes-toolchain/bbappends/linux-msm_%.bbappend ${LAYERDIR}/recipes-toolchain/bbappends/packagegroup-qti-gst.bbappend",d)}"

BBPATH .= ":${LAYERDIR}/"
BBFILE_COLLECTIONS += "ubuntu"
BBFILE_PRIORITY_ubuntu = "15"
BBFILE_PATTERN_ubuntu := "^${LAYERDIR}/"
export GOPROXY="https://goproxy.io,direct"

PNBLACKLIST[musl] = "musl is mismatch with COMPATIBLE_HOST"
```
